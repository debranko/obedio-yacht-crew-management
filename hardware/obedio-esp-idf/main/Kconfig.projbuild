## hardware/obedio-esp-idf/main/Kconfig.projbuild
```kconfig
menu "OBEDIO Button Configuration"

    menu "WiFi Configuration"
        config OBEDIO_WIFI_SSID
            string "WiFi SSID"
            default "Obedio"
            help
                WiFi network name (SSID)

        config OBEDIO_WIFI_PASSWORD
            string "WiFi Password"
            default "BrankomeinBruder:)"
            help
                WiFi network password

        config OBEDIO_WIFI_MAXIMUM_RETRY
            int "Maximum WiFi retry attempts"
            default 10
            help
                Maximum number of WiFi connection retry attempts
    endmenu

    menu "MQTT Configuration"
        config OBEDIO_MQTT_BROKER_URI
            string "MQTT Broker URI"
            default "mqtt://10.10.0.10:1883"
            help
                MQTT broker address (format: mqtt://IP:PORT)

        config OBEDIO_MQTT_BUFFER_SIZE
            int "MQTT Buffer Size"
            default 4096
            range 1024 8192
            help
                MQTT message buffer size in bytes
    endmenu

    menu "Hardware Configuration"
        config OBEDIO_I2C_SDA_GPIO
            int "I2C SDA GPIO"
            default 3
            help
                I2C SDA pin number

        config OBEDIO_I2C_SCL_GPIO
            int "I2C SCL GPIO"
            default 2
            help
                I2C SCL pin number

        config OBEDIO_LED_GPIO
            int "NeoPixel LED GPIO"
            default 17
            help
                GPIO pin for WS2812B LED strip

        config OBEDIO_LED_COUNT
            int "Number of LEDs"
            default 16
            range 1 256
            help
                Number of NeoPixel LEDs in the strip

        config OBEDIO_TOUCH_GPIO
            int "Touch Sensor GPIO"
            default 1
            help
                GPIO pin for capacitive touch sensor (ESP32-S3 touch pad)
    endmenu

    menu "Audio Configuration"
        config OBEDIO_AUDIO_SAMPLE_RATE
            int "Audio Sample Rate (Hz)"
            default 16000
            help
                Sample rate for voice recording (8000 or 16000 recommended)

        config OBEDIO_AUDIO_MAX_DURATION
            int "Maximum Recording Duration (seconds)"
            default 20
            range 1 60
            help
                Maximum voice recording duration

        config OBEDIO_I2S_MIC_BCK_GPIO
            int "I2S Microphone BCK GPIO"
            default 33
            help
                I2S bit clock pin for microphone

        config OBEDIO_I2S_MIC_WS_GPIO
            int "I2S Microphone WS GPIO"
            default 38
            help
                I2S word select (LRCLK) pin for microphone

        config OBEDIO_I2S_MIC_DATA_GPIO
            int "I2S Microphone DATA GPIO"
            default 34
            help
                I2S data pin for microphone

        config OBEDIO_I2S_SPK_BCK_GPIO
            int "I2S Speaker BCK GPIO"
            default 10
            help
                I2S bit clock pin for speaker

        config OBEDIO_I2S_SPK_WS_GPIO
            int "I2S Speaker WS GPIO"
            default 18
            help
                I2S word select (LRCLK) pin for speaker

        config OBEDIO_I2S_SPK_DATA_GPIO
            int "I2S Speaker DATA GPIO"
            default 11
            help
                I2S data pin for speaker

        config OBEDIO_I2S_SPK_ENABLE_GPIO
            int "Speaker Enable GPIO"
            default 14
            help
                GPIO to enable/disable speaker amplifier
    endmenu

    menu "Sensor Configuration"
        config OBEDIO_SHAKE_THRESHOLD
            int "Shake Detection Threshold (x100)"
            default 350
            range 100 1000
            help
                Shake detection threshold in G-force * 100
                Example: 350 = 3.5G

        config OBEDIO_TOUCH_THRESHOLD_PERCENT
            int "Touch Threshold Percentage"
            default 80
            range 50 95
            help
                Touch detection threshold as percentage of baseline
                Lower = more sensitive

        config OBEDIO_LED_BRIGHTNESS
            int "LED Brightness (0-255)"
            range 0 255
            default 200
            help
                NeoPixel LED brightness level
    endmenu

    menu "Timing Configuration"
        config OBEDIO_DEBOUNCE_DELAY_MS
            int "Button Debounce Delay (ms)"
            default 50
            range 10 200
            help
                Button debounce delay in milliseconds

        config OBEDIO_LONG_PRESS_TIME_MS
            int "Long Press Duration (ms)"
            default 700
            range 300 3000
            help
                Minimum duration for long press detection

        config OBEDIO_DOUBLE_CLICK_WINDOW_MS
            int "Double-Click Window (ms)"
            default 500
            range 200 1000
            help
                Maximum time between clicks for double-click
    endmenu

endmenu
```

## hardware/obedio-esp-idf/sdkconfig.defaults
```kconfig
#
# OBEDIO Button - ESP-IDF Configuration Defaults
# ESP32-S3 Custom PCB with 8MB Flash, 2MB PSRAM
#

# ==================== ESP32-S3 Target ====================
CONFIG_IDF_TARGET="esp32s3"
CONFIG_IDF_TARGET_ESP32S3=y

# ==================== CPU & Performance ====================
CONFIG_ESP32S3_DEFAULT_CPU_FREQ_240=y
CONFIG_ESP32S3_DATA_CACHE_64KB=y
CONFIG_ESP32S3_INSTRUCTION_CACHE_32KB=y

# ==================== Flash Configuration ====================
CONFIG_ESPTOOLPY_FLASHSIZE_8MB=y
CONFIG_ESPTOOLPY_FLASHSIZE="8MB"
CONFIG_ESPTOOLPY_FLASHMODE_QIO=y
CONFIG_ESPTOOLPY_FLASHFREQ_80M=y

# ==================== Partition Table (OTA Support) ====================
CONFIG_PARTITION_TABLE_CUSTOM=y
CONFIG_PARTITION_TABLE_CUSTOM_FILENAME="partitions.csv"
CONFIG_PARTITION_TABLE_FILENAME="partitions.csv"

# ==================== PSRAM Configuration ====================
CONFIG_SPIRAM=y
CONFIG_SPIRAM_MODE_OCT=y
CONFIG_SPIRAM_SPEED_80M=y
CONFIG_SPIRAM_USE_MALLOC=y
CONFIG_SPIRAM_MALLOC_ALWAYSINTERNAL=16384
CONFIG_SPIRAM_TRY_ALLOCATE_WIFI_LWIP=y

# ==================== WiFi Configuration ====================
CONFIG_ESP_WIFI_STATIC_RX_BUFFER_NUM=10
CONFIG_ESP_WIFI_DYNAMIC_RX_BUFFER_NUM=32
CONFIG_ESP_WIFI_DYNAMIC_TX_BUFFER_NUM=32
CONFIG_ESP_WIFI_TX_BUFFER_TYPE=1
CONFIG_ESP_WIFI_AMPDU_TX_ENABLED=y
CONFIG_ESP_WIFI_AMPDU_RX_ENABLED=y
CONFIG_ESP_WIFI_NVS_ENABLED=y
CONFIG_ESP_WIFI_TASK_PINNED_TO_CORE_0=y

# ==================== LWIP (TCP/IP Stack) ====================
CONFIG_LWIP_MAX_SOCKETS=16
CONFIG_LWIP_SO_REUSE=y
CONFIG_LWIP_SO_REUSE_RXTOALL=y
CONFIG_LWIP_TCP_MSS=1440
CONFIG_LWIP_TCP_SND_BUF_DEFAULT=5744
CONFIG_LWIP_TCP_WND_DEFAULT=5744
CONFIG_LWIP_TCP_RECVMBOX_SIZE=6
CONFIG_LWIP_UDP_RECVMBOX_SIZE=6
CONFIG_LWIP_TCPIP_RECVMBOX_SIZE=32
CONFIG_LWIP_LOCAL_HOSTNAME="obedio-button"

# ==================== mDNS ====================
CONFIG_MDNS_MAX_SERVICES=10

# ==================== HTTP Server ====================
CONFIG_HTTPD_MAX_REQ_HDR_LEN=1024
CONFIG_HTTPD_MAX_URI_LEN=512
CONFIG_HTTPD_WS_SUPPORT=y

# ==================== MQTT ====================
CONFIG_MQTT_BUFFER_SIZE=4096
CONFIG_MQTT_TASK_STACK_SIZE=6144
CONFIG_MQTT_DISABLE_API_LOCKS=n
CONFIG_MQTT_TASK_PRIORITY=5
CONFIG_MQTT_USE_CUSTOM_CONFIG=n

# ==================== FreeRTOS ====================
CONFIG_FREERTOS_HZ=1000
CONFIG_FREERTOS_UNICORE=n
CONFIG_FREERTOS_WATCHPOINT_END_OF_STACK=y
CONFIG_FREERTOS_THREAD_LOCAL_STORAGE_POINTERS=1
CONFIG_FREERTOS_SUPPORT_STATIC_ALLOCATION=y
CONFIG_FREERTOS_TIMER_TASK_STACK_DEPTH=3072

# ==================== Logging ====================
CONFIG_LOG_DEFAULT_LEVEL_INFO=y
CONFIG_LOG_DEFAULT_LEVEL=3
CONFIG_LOG_COLORS=y
CONFIG_LOG_TIMESTAMP_SOURCE_RTOS=y

# ==================== NVS ====================
CONFIG_NVS_ENCRYPTION=n

# ==================== Touch Sensor ====================
CONFIG_SOC_TOUCH_SENSOR_NUM=14
CONFIG_SOC_TOUCH_PROXIMITY_CHANNEL_NUM=3

# ==================== I2S (Audio) ====================
CONFIG_I2S_ISR_IRAM_SAFE=y
CONFIG_I2S_SUPPRESS_DEPRECATE_WARN=y

# ==================== RMT (NeoPixels) ====================
CONFIG_RMT_ISR_IRAM_SAFE=y

# ==================== Main Task ====================
CONFIG_ESP_MAIN_TASK_STACK_SIZE=8192
CONFIG_ESP_MAIN_TASK_AFFINITY_CPU0=y

# ==================== System ====================
CONFIG_ESP_SYSTEM_EVENT_QUEUE_SIZE=32
CONFIG_ESP_SYSTEM_EVENT_TASK_STACK_SIZE=4096
CONFIG_ESP_INT_WDT_TIMEOUT_MS=800
CONFIG_ESP_TASK_WDT=y
CONFIG_ESP_TASK_WDT_TIMEOUT_S=10
CONFIG_ESP_TASK_WDT_PANIC=y
CONFIG_ESP_TASK_WDT_CHECK_IDLE_TASK_CPU0=y
CONFIG_ESP_TASK_WDT_CHECK_IDLE_TASK_CPU1=y

# ==================== Bootloader ====================
CONFIG_BOOTLOADER_LOG_LEVEL_INFO=y
CONFIG_BOOTLOADER_APP_ROLLBACK_ENABLE=y

# ==================== Compiler Options ====================
CONFIG_COMPILER_OPTIMIZATION_SIZE=y
CONFIG_COMPILER_OPTIMIZATION_ASSERTIONS_ENABLE=y
CONFIG_COMPILER_STACK_CHECK_MODE_NORM=y

# ==================== OTA ====================
CONFIG_OTA_ALLOW_HTTP=y
CONFIG_BOOTLOADER_APP_ROLLBACK_ENABLE=y

# ==================== SPIFFS (for web assets) ====================
CONFIG_SPIFFS_MAX_PARTITIONS=3
```
